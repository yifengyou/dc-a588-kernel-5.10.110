## drivers/net/usb/gobiNet/Kconfig
```kconfig
config GobiUSBNet
   
             bool "GobiUSBNet driver"
             default y
             help
			 
config QMI
   
			bool "QMI driver"
            default y
            help	

config QMIDevice
   
            bool "QMIDevice driver"
            default y
            help	
```
